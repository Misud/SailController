/*
    OLED
    用于管理OLED相关代码
*/

#include "OLED.h"
#include "I2C.h"
#include <string.h>
#include <stdio.h>

/*显存缓冲区：128*64/8 = 1024字节*/
uint8_t oled_buf[OLED_WIDTH * OLED_HEIGHT / 8];

/*保存 I2C 句柄*/
SoftI2C_t *oled_i2c;


/*==========6*8 ASCII 字库==========*/
// 常用字符，从空格（0x20）开始，共95个
static const uint8_t font6x8[][6] = {
    {0x00,0x00,0x00,0x00,0x00,0x00}, // 空格
    {0x00,0x00,0x5F,0x00,0x00,0x00}, // !
    {0x00,0x07,0x00,0x07,0x00,0x00}, // "
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    {0x08,0x08,0x2A,0x1C,0x08,0x00}, // ~
};


/*==========写命令==========*/
static void OLED_WriteCmd(uint8_t cmd)
{
    SoftI2C_Start(oled_i2c);
    SoftI2C_SendByte(oled_i2c, (OLED_ADDR << 1) | 0);
    SoftI2C_SendByte(oled_i2c, 0x00);                   // 控制字节：命令
    SoftI2C_SendByte(oled_i2c, cmd);
    SoftI2C_Stop(oled_i2c);
}


/*==========写数据==========*/
static void OLED_WriteData(uint8_t data)
{
    SoftI2C_Start(oled_i2c);
    SoftI2C_SendByte(oled_i2c, (OLED_ADDR << 1) | 0);
    SoftI2C_SendByte(oled_i2c, 0x40);                   // 控制字节：数据
    SoftI2C_SendByte(oled_i2c, data);
    SoftI2C_Stop(oled_i2c);
}


/*==========设置显示位置==========*/
static void OLED_SetPos(uint8_t x, uint8_t y)
{
    OLED_WriteCmd(0xB0 + y);                            // 页地址
    OLED_WriteCmd(((x & 0xF0) >> 4) | 0x10);            // 列高4位
    OLED_WriteCmd((x & 0x0F) | 0x00);                   // 列低4位
}


/*==========初始化==========*/
void OLED_Init(SoftI2C_t *i2c)
{
    oled_i2c = i2c;

    HAL_Delay(100);     // 上电等待OLED内部复位

    OLED_WriteCmd(0xAE); // 关闭显示
    OLED_WriteCmd(0xD5); // 时钟分频
    OLED_WriteCmd(0x80);
    OLED_WriteCmd(0xA8); // 多路复用
    OLED_WriteCmd(0x3F);
    OLED_WriteCmd(0xD3); // 显示偏移
    OLED_WriteCmd(0x00);
    OLED_WriteCmd(0x40); // 起始行
    OLED_WriteCmd(0x8D); // 电荷泵
    OLED_WriteCmd(0x14);
    OLED_WriteCmd(0x20); // 寻址模式
    OLED_WriteCmd(0x02);
    OLED_WriteCmd(0xA1); // 段重映射
    OLED_WriteCmd(0xC8); // COM扫描方向
    OLED_WriteCmd(0xDA);
    OLED_WriteCmd(0x12);
    OLED_WriteCmd(0x81); // 对比度
    OLED_WriteCmd(0x7F);
    OLED_WriteCmd(0xD9); // 预充电
    OLED_WriteCmd(0xF1);
    OLED_WriteCmd(0xDB);
    OLED_WriteCmd(0x40);
    OLED_WriteCmd(0xA4);
    OLED_WriteCmd(0xA6);
    OLED_WriteCmd(0xAF); // 开显示
    
    OLED_Clear();
    OLED_Refresh();
}


/*==========清屏==========*/
void OLED_Clear(void)
{
    memset(oled_buf, 0x00, sizeof(oled_buf));
}


/*==========刷新，把缓冲区整个写到屏幕==========*/
void OLED_Refresh(void)
{
    for(uint8_t page = 0; page < 8; page++)
    {
        OLED_SetPos(0, page);
        for(uint8_t col = 0; col < 128; col++)
        {
            OLED_WriteData(oled_buf[page * 128 + col]);
        }
    }
}


/*==========全亮==========*/
void OLED_TestAllOn(void)
{
    memset(oled_buf, 0xFF, sizeof(oled_buf));
    OLED_Refresh();
}


/*==========显示一个字符==========*/
/* x：0~127 y：0~7（页号，每页8像素高） */
void OLED_ShowChar(uint8_t x, uint8_t y, char ch)
{
    if(ch < ' ' || ch > '~')
        ch = ' ';           // 越界显示空格
    uint8_t idx = ch - ' ';
    for(uint8_t i = 0; i < 6; i++)
    {
        if(x + i < 128)
        {
            oled_buf[y * 128 + x + i] = font6x8[idx][i];
        }
    }
}


/*===========显示字符串===========*/
void OLED_ShowString(uint8_t x, uint8_t y, const char *str)
{
    while(*str)
    {
        OLED_ShowChar(x, y, *str);
        x += 6;
        if (x > 122)
        {
            x = 0;
            y++;
        }               // 换行
        str++;
    }
}


/*==========显示整数==========*/
void OLED_ShowInt(uint8_t x, uint8_t y, int32_t num)
{
    char buf[16];
    sprintf(buf, "%ld", (long)num);
    OLED_ShowString(x, y, buf);
}


/*==========显示浮点数==========*/
void OLED_ShowFloat(uint8_t x, uint8_t y, float num, uint8_t decimals)
{
    char buf[24];
    char fmt[8];
    sprintf(fmt, "%%.%df", decimals);
    sprintf(buf, fmt, num);
    OLED_ShowString(x, y, buf);
}